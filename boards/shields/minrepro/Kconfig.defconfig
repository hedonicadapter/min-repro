## boards/shields/minrepro/Kconfig.defconfig
```kconfig
if MINREPRO_LEFT

# Name must be less than 16 characters long!
config ZMK_KEYBOARD_NAME
    default "Minrepro"

config ZMK_SPLIT_ROLE_CENTRAL
    default y

endif

if MINREPRO_LEFT || MINREPRO_RIGHT

config ZMK_SPLIT
    default y


config ZMK_POINTING
    default y

config ZMK_POINTING_SMOOTH_SCROLLING
    default y

config SPI
    default y

config PMW3610
    default y

config PMW3610_INIT_POWER_UP_EXTRA_DELAY_MS
    default 2000

endif
```

## boards/shields/minrepro/Kconfig.shield
```kconfig
config MINREPRO_LEFT
    def_bool $(shields_list_contains,minrepro_left)

config MINREPRO_RIGHT
    def_bool $(shields_list_contains,minrepro_right)
```
